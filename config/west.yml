## config/west.yml
```yaml
manifest:
  remotes:
    - name: zmkfirmware
      url-base: https://github.com/lukaslukasm/zmk-builder
  projects:
    - name: zmk-builder
      remote: zmkfirmware
      revision: main
      import: app/west.yml
  self:
    path: config
```
